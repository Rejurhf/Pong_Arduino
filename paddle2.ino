/*
Rejurhf 
21.04.2018
*/
#include <LedControl.h>

//JoyStick conection
const int SW_pin = 2; // digital pin connected to switch output
const int X_pin = 0; // analog pin connected to X output    podłączyć do    !!! A0 !!!
const int Y_pin = 1; // analog pin connected to Y output    podłączyć do    !!! A1 !!!

//8x8 Led conection
int DIN = 5;   //DIN port 5
int CS =  4;   //CS port 4
int CLK = 3;   //CLK port 3
LedControl lc = LedControl(DIN,CLK,CS,0); //LED setup

//global variables
byte paddlePos[8] = {0,0,0,0,0,0,0,0};    //paddle array to display
int paddDotPos = 2;         //Position of paddle main dot (-5 - 8)
int rSize = 3;              //length of the paddle (number 1-5)
int xCount = 0;             //Counter of X switched in order to commit acction
int yCount = 0;             //Counter of Y switched in order to commit acction
int switchCount = 0;        //Counter of SW switched in order to commit acction

int tmpPrntCount = 0;       //ONLY FOR TESTING, counter for printing array in monitor

void setup() {
  lc.shutdown(0,false);     //The MAX72XX is in power-saving mode on startup
  lc.setIntensity(0,1);     // Set the brightness
  lc.clearDisplay(0);       // and clear the display
  pinMode(SW_pin, INPUT);
  digitalWrite(SW_pin, HIGH);
  Serial.begin(115200);
  convPaddleToSize();   //initial fill paddle array, cause at start is empty
}



void loop() {
  ++tmpPrntCount;       //new iteration increase counter
  checkCounters();      //check if something is switched, and if there is action to do  
  
  if(tmpPrntCount >= 5){ //ONLY FOR TESTING, display tings in monitor
    tmpPrntCount = 0;     //prints array in monitor every 5 iterations
    Serial.println(rSize);
    printArray(paddlePos); 
  }   //after 5 iterations print paddle array and make counter = 0
  
  // lc.clearDisplay(0);               //clear display
  printByte(paddlePos);       //display paddle on a screen
  delay(100);
}



void printArray(byte arr[]){      
  for(int i = 0; i < 8; ++i){
    Serial.print(arr[i], DEC); 
    Serial.print(", "); 
  }
  Serial.println();
}        //print send array in monitor


void printByte(byte character[]){  
  for(int i = 0; i < 8; ++i){
    lc.setRow(0,i,character[i]);
  }
}       //print send array on screen


void checkCounters(){
  int xRead = analogRead(X_pin);              //Read of analog X in
  int yRead = analogRead(Y_pin);              //Read of analog Y in
  int switchRead = digitalRead(SW_pin);       //Read of digital SW in
  
  // if(xRead > 700 && XCount >= 0){             //check if X is switched right, and if there wasnt fast changes between states (>=0)
  //   ++xCount;                                 //if true add
  // }else if(xRead < 300 && xCount <= 0){       //same as above, but for switched left 
  //   --xCount;                                     
  // }else if(xRead >= 300 && xRead <= 700 & xCount != 0){     //if not switched and counter != 0, make 0
  //   xCount = 0;
  // }
  
  if(yRead > 700 && yCount >= 0){             //same as above, but for Y
    ++yCount;
  }else if(yRead < 300 && yCount <= 0){
    --yCount;
  }else if(yRead >= 300 && yRead <= 700 & yCount != 0){
    yCount = 0;
  }
  
  if(switchRead == 0){             //if Switch presed, increase counter
    ++switchCount;
  }else if(switchRead == 1 & switchCount != 0){  //if Switch relesed and counter != 0, make counter = 0
    switchCount = 0;
  }
  
  // if(xCount >= 10){       //if X was switched left for 10 iterations print text and make counter = 0
  //   xCount = 0;
  //   Serial.println("Right");
  // }else if(xCount <= -10){      //same as above but for X switched Right
  //   xCount = 0;
  //   Serial.println("Left");
  // }
  
  if(yCount >= 3){       //if Y was switched down for 10 iterations print text and make counter = 0
    yCount = 0;
    if(paddDotPos < 8){   //if smaller than max value, go down
      ++paddDotPos;
      convPaddleToSize();
    }
    Serial.println("Down");
  }else if(yCount <= -3){      //same as above but for Y switched up
    yCount = 0;
    if(paddDotPos > (-1*rSize)){    //if bigger than min value, go up
      --paddDotPos;
      convPaddleToSize();
    }
    Serial.println("Up");
  }
  
  if(switchCount == 3){   //if Switch was pressed for 3 iterations print "Short"
    Serial.println("Short press");
  }else if(switchCount != 0 && (switchCount % 10) == 0){
    if(rSize == 5){       //if paddle reach max size make 1 again
      rSize = 1;
      if(paddDotPos < -1)   //if paddle out of screen on the top on index < -1 move the dot 
        paddDotPos = -1;    //to index -1 for easier going out of there
    }else if(rSize < 5 && rSize >= 0){
      ++rSize;
    }   //if Switch was pressed for multiple 10 iterations print "Long" change rSize
    convPaddleToSize();
    Serial.println("Long press");
  }
}       //check if something is switched, and if there is action to do


void convPaddleToSize(){
  for(int i = 0; i < 8; ++i){     //conversion to display paddle array
    if(i >= paddDotPos && i < (paddDotPos + rSize))
      paddlePos[i] = 1;
    else
      paddlePos[i] = 0;
  }
}       //special function to convert paddle from 1 point to rSize paddle